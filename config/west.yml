## config/west.yml
```yaml
manifest:
  remotes:
    - name: zmkfirmware
      url-base: https://github.com/zmkfirmware
    - name: Dist16384
      url-base: https://github.com/Dist16384
  projects:
    - name: zmk
      remote: zmkfirmware
      revision: e34793e8c7193bc868b95ec38d78f67956f759cb
      import: app/west.yml
    - name: zmk-pmw3610-driver
      remote: Dist16384
      revision: main
  self:
    path: config
```
